## boards/shields/pond/Kconfig.defconfig
```kconfig
if SHIELD_POND_LEFT

config ZMK_KEYBOARD_NAME
    default "Pond Board"

config ZMK_SPLIT_ROLE_CENTRAL
    default y

endif 

if SHIELD_POND_LEFT || SHIELD_POND_RIGHT

config ZMK_SPLIT
    default y

endif # SHIELD_POND_LEFT || SHIELD_POND_RIGHT
```

## boards/shields/pond/Kconfig.shield
```kconfig
config SHIELD_POND_LEFT
    def_bool $(shields_list_contains,pond_left)

config SHIELD_POND_RIGHT
    def_bool $(shields_list_contains,pond_right)
```
